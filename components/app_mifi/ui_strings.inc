static void apply_scene_strings(struct app_mifi *state)
{
    const bool en = state->english;
    remember_error(state, gsp_mifi_carrier_set_text(state->ui, en ? "China Unicom 4G" : "中国联通 4G"));
    remember_error(state, gsp_mifi_download_caption_set_text(state->ui, en ? "Download" : "实时下载"));
    remember_error(state, gsp_mifi_month_caption_set_text(state->ui, en ? "Data" : "本月"));
    remember_error(state, gsp_mifi_home_devices_caption_set_text(state->ui, en ? "Devices" : "设备"));
    remember_error(state, gsp_mifi_runtime_caption_set_text(state->ui, en ? "Battery" : "续航"));
    remember_error(state, gsp_mifi_runtime_value_set_text(state->ui, en ? "~8h" : "约 8h"));
    remember_error(state, gsp_mifi_redial_button_set_text(state->ui, en ? "　Redial" : "　重新拨号"));
    remember_error(state, gsp_mifi_nav_0_0_set_text(state->ui, en ? "Home" : "首页"));
    remember_error(state, gsp_mifi_nav_0_1_set_text(state->ui, en ? "Wi-Fi" : "Wi-Fi"));
    remember_error(state, gsp_mifi_nav_0_2_set_text(state->ui, en ? "Devices" : "设备"));
    remember_error(state, gsp_mifi_nav_0_3_set_text(state->ui, en ? "Cellular" : "蜂窝"));
    remember_error(state, gsp_mifi_nav_0_4_set_text(state->ui, en ? "System" : "系统"));
    remember_error(state, gsp_mifi_title_wifi_carrier_set_text(state->ui, en ? "China Unicom 4G" : "中国联通 4G"));
    remember_error(state, gsp_mifi_title_wifi_set_text(state->ui, en ? "Wi-Fi" : "Wi-Fi 设置"));
    remember_error(state, gsp_mifi_wifi_scan_set_text(state->ui, en ? "Tap to zoom" : "点击放大"));
    remember_error(state, gsp_mifi_wifi_name_title_set_text(state->ui, en ? "Hotspot name" : "热点名称"));
    remember_error(state, gsp_mifi_wifi_security_title_set_text(state->ui, en ? "Security" : "安全"));
    remember_error(state, gsp_mifi_wifi_band_title_set_text(state->ui, en ? "2.4G Channel" : "2.4G 信道"));
    remember_error(state, gsp_mifi_wifi_max_conn_title_set_text(state->ui, en ? "Max devices" : "最大连接数"));
    remember_error(state, gsp_mifi_nav_1_0_set_text(state->ui, en ? "Home" : "首页"));
    remember_error(state, gsp_mifi_nav_1_1_set_text(state->ui, en ? "Wi-Fi" : "Wi-Fi"));
    remember_error(state, gsp_mifi_nav_1_2_set_text(state->ui, en ? "Devices" : "设备"));
    remember_error(state, gsp_mifi_nav_1_3_set_text(state->ui, en ? "Cellular" : "蜂窝"));
    remember_error(state, gsp_mifi_nav_1_4_set_text(state->ui, en ? "System" : "系统"));
    remember_error(state, gsp_mifi_ch_off_0_set_text(state->ui, en ? "Auto" : "自动"));
    remember_error(state, gsp_mifi_ch_on_lbl_0_set_text(state->ui, en ? "Auto" : "自动"));
    remember_error(state, gsp_mifi_ch_off_1_set_text(state->ui, en ? "Ch 1" : "信道 1"));
    remember_error(state, gsp_mifi_ch_on_lbl_1_set_text(state->ui, en ? "Ch 1" : "信道 1"));
    remember_error(state, gsp_mifi_ch_off_2_set_text(state->ui, en ? "Ch 2" : "信道 2"));
    remember_error(state, gsp_mifi_ch_on_lbl_2_set_text(state->ui, en ? "Ch 2" : "信道 2"));
    remember_error(state, gsp_mifi_ch_off_3_set_text(state->ui, en ? "Ch 3" : "信道 3"));
    remember_error(state, gsp_mifi_ch_on_lbl_3_set_text(state->ui, en ? "Ch 3" : "信道 3"));
    remember_error(state, gsp_mifi_ch_off_4_set_text(state->ui, en ? "Ch 4" : "信道 4"));
    remember_error(state, gsp_mifi_ch_on_lbl_4_set_text(state->ui, en ? "Ch 4" : "信道 4"));
    remember_error(state, gsp_mifi_ch_off_5_set_text(state->ui, en ? "Ch 5" : "信道 5"));
    remember_error(state, gsp_mifi_ch_on_lbl_5_set_text(state->ui, en ? "Ch 5" : "信道 5"));
    remember_error(state, gsp_mifi_ch_off_6_set_text(state->ui, en ? "Ch 6" : "信道 6"));
    remember_error(state, gsp_mifi_ch_on_lbl_6_set_text(state->ui, en ? "Ch 6" : "信道 6"));
    remember_error(state, gsp_mifi_ch_off_7_set_text(state->ui, en ? "Ch 7" : "信道 7"));
    remember_error(state, gsp_mifi_ch_on_lbl_7_set_text(state->ui, en ? "Ch 7" : "信道 7"));
    remember_error(state, gsp_mifi_ch_off_8_set_text(state->ui, en ? "Ch 8" : "信道 8"));
    remember_error(state, gsp_mifi_ch_on_lbl_8_set_text(state->ui, en ? "Ch 8" : "信道 8"));
    remember_error(state, gsp_mifi_ch_off_9_set_text(state->ui, en ? "Ch 9" : "信道 9"));
    remember_error(state, gsp_mifi_ch_on_lbl_9_set_text(state->ui, en ? "Ch 9" : "信道 9"));
    remember_error(state, gsp_mifi_ch_off_10_set_text(state->ui, en ? "Ch 10" : "信道 10"));
    remember_error(state, gsp_mifi_ch_on_lbl_10_set_text(state->ui, en ? "Ch 10" : "信道 10"));
    remember_error(state, gsp_mifi_ch_off_11_set_text(state->ui, en ? "Ch 11" : "信道 11"));
    remember_error(state, gsp_mifi_ch_on_lbl_11_set_text(state->ui, en ? "Ch 11" : "信道 11"));
    remember_error(state, gsp_mifi_ch_off_12_set_text(state->ui, en ? "Ch 12" : "信道 12"));
    remember_error(state, gsp_mifi_ch_on_lbl_12_set_text(state->ui, en ? "Ch 12" : "信道 12"));
    remember_error(state, gsp_mifi_ch_off_13_set_text(state->ui, en ? "Ch 13" : "信道 13"));
    remember_error(state, gsp_mifi_ch_on_lbl_13_set_text(state->ui, en ? "Ch 13" : "信道 13"));
    remember_error(state, gsp_mifi_title_hotspot_set_text(state->ui, en ? "Hotspot" : "热点设置"));
    remember_error(state, gsp_mifi_setup_name_label_set_text(state->ui, en ? "Hotspot name" : "热点名称"));
    remember_error(state, gsp_mifi_setup_pass_label_set_text(state->ui, en ? "Password" : "密码"));
    remember_error(state, gsp_mifi_devices_carrier_set_text(state->ui, en ? "China Unicom 4G" : "中国联通 4G"));
    remember_error(state, gsp_mifi_devices_title_set_text(state->ui, en ? "Online devices" : "在线设备"));
    remember_error(state, gsp_mifi_devices_empty_title_set_text(state->ui, en ? "No devices online" : "没有在线设备"));
    remember_error(state, gsp_mifi_devices_empty_detail_set_text(state->ui, en ? "Turn the hotspot on to see phones here" : "打开热点后，手机会出现在这里"));
    remember_error(state, gsp_mifi_blacklist_button_set_text(state->ui, en ? "　　　 Blocklist  1" : "　　　 黑名单  1"));
    remember_error(state, gsp_mifi_schedule_button_set_text(state->ui, en ? "　　　 Time schedule" : "　　　 上网时间管理"));
    remember_error(state, gsp_mifi_pause_button_set_text(state->ui, en ? "　　　Pause all" : "　　　暂停所有设备"));
    remember_error(state, gsp_mifi_nav_2_0_set_text(state->ui, en ? "Home" : "首页"));
    remember_error(state, gsp_mifi_nav_2_1_set_text(state->ui, en ? "Wi-Fi" : "Wi-Fi"));
    remember_error(state, gsp_mifi_nav_2_2_set_text(state->ui, en ? "Devices" : "设备"));
    remember_error(state, gsp_mifi_nav_2_3_set_text(state->ui, en ? "Cellular" : "蜂窝"));
    remember_error(state, gsp_mifi_nav_2_4_set_text(state->ui, en ? "System" : "系统"));
    remember_error(state, gsp_mifi_detail_quota_title_set_text(state->ui, en ? "Session limit" : "允许上网时长"));
    remember_error(state, gsp_mifi_detail_close_btn_set_text(state->ui, en ? "Done" : "完成"));
    remember_error(state, gsp_mifi_detail_block_btn_set_text(state->ui, en ? "Add to blocklist" : "加入黑名单"));
    remember_error(state, gsp_mifi_bl_modal_title_set_text(state->ui, en ? "Blocklist" : "黑名单管理"));
    remember_error(state, gsp_mifi_bl_btn_0_set_text(state->ui, en ? "Unblock" : "移出"));
    remember_error(state, gsp_mifi_bl_btn_1_set_text(state->ui, en ? "Unblock" : "移出"));
    remember_error(state, gsp_mifi_bl_btn_2_set_text(state->ui, en ? "Unblock" : "移出"));
    remember_error(state, gsp_mifi_bl_empty_label_set_text(state->ui, en ? "No blocked devices" : "黑名单为空"));
    remember_error(state, gsp_mifi_bl_done_btn_set_text(state->ui, en ? "Close" : "关闭"));
    remember_error(state, gsp_mifi_title_cellular_carrier_set_text(state->ui, en ? "China Unicom 4G" : "中国联通 4G"));
    remember_error(state, gsp_mifi_title_cellular_set_text(state->ui, en ? "Cellular" : "蜂窝网络"));
    remember_error(state, gsp_mifi_cell_registered_set_text(state->ui, en ? "● Registered" : "● 已注册"));
    remember_error(state, gsp_mifi_cell_operator_set_text(state->ui, en ? "China Unicom 4G" : "中国联通 4G"));
    remember_error(state, gsp_mifi_cell_link_set_text(state->ui, en ? "LTE Band 3 · Online" : "LTE Band 3 · 已联网"));
    remember_error(state, gsp_mifi_cell_redial_set_text(state->ui, en ? "　Redial" : "　重新拨号"));
    remember_error(state, gsp_mifi_cell_sig_title_set_text(state->ui, en ? "Signal" : "信号质量"));
    remember_error(state, gsp_mifi_cell_sig_value_set_text(state->ui, en ? "Good (-92dBm)" : "良好 (-92dBm)"));
    remember_error(state, gsp_mifi_cell_data_title_set_text(state->ui, en ? "Data used" : "本月流量"));
    remember_error(state, gsp_mifi_cell_data_value_set_text(state->ui, en ? "18.6 GB" : "18.6 GB"));
    remember_error(state, gsp_mifi_cell_ip_title_set_text(state->ui, en ? "WAN IP" : "分配 IP"));
    remember_error(state, gsp_mifi_cell_ip_value_set_text(state->ui, en ? "10.68.142.19" : "10.68.142.19"));
    remember_error(state, gsp_mifi_sim_card_title_set_text(state->ui, en ? "SIM card" : "SIM 卡"));
    remember_error(state, gsp_mifi_sim_card_value_set_text(state->ui, en ? "Ready" : "已就绪"));
    remember_error(state, gsp_mifi_apn_title_set_text(state->ui, en ? "APN" : "APN"));
    remember_error(state, gsp_mifi_apn_value_set_text(state->ui, en ? "CMNET" : "CMNET"));
    remember_error(state, gsp_mifi_cell_roaming_set_text(state->ui, en ? "　 Data roaming" : "　 数据漫游"));
    remember_error(state, gsp_mifi_nav_3_0_set_text(state->ui, en ? "Home" : "首页"));
    remember_error(state, gsp_mifi_nav_3_1_set_text(state->ui, en ? "Wi-Fi" : "Wi-Fi"));
    remember_error(state, gsp_mifi_nav_3_2_set_text(state->ui, en ? "Devices" : "设备"));
    remember_error(state, gsp_mifi_nav_3_3_set_text(state->ui, en ? "Cellular" : "蜂窝"));
    remember_error(state, gsp_mifi_nav_3_4_set_text(state->ui, en ? "System" : "系统"));
    remember_error(state, gsp_mifi_system_carrier_set_text(state->ui, en ? "China Unicom 4G" : "中国联通 4G"));
    remember_error(state, gsp_mifi_title_system_set_text(state->ui, en ? "System" : "系统"));
    remember_error(state, gsp_mifi_language_row_set_text(state->ui, en ? "　 EN" : "　 中文"));
    remember_error(state, gsp_mifi_battery_summary_set_text(state->ui, en ? "82% · about 8 h" : "82% · 约 8 小时"));
    remember_error(state, gsp_mifi_battery_detail_set_text(state->ui, en ? "42°C  Normal" : "42°C  正常"));
    remember_error(state, gsp_mifi_battery_hw_set_text(state->ui, en ? "Discharging · 4.02 V" : "放电中 · 4.02 V"));
    remember_error(state, gsp_mifi_power_save_set_text(state->ui, en ? "　　　 Power saving" : "　　　 省电模式"));
    remember_error(state, gsp_mifi_brightness_set_text(state->ui, en ? "Brightness" : "屏幕亮度"));
    remember_error(state, gsp_mifi_sleep_row_set_text(state->ui, en ? "Auto sleep" : "自动息屏"));
    remember_error(state, gsp_mifi_diag_row_set_text(state->ui, en ? "　　　 Diagnostics   All healthy" : "　　　 网络诊断   全部正常"));
    remember_error(state, gsp_mifi_update_row_set_text(state->ui, en ? "　　　 System update   Up to date" : "　　　 系统更新   已是最新"));
    remember_error(state, gsp_mifi_logs_row_set_text(state->ui, en ? "　　　 Runtime logs" : "　　　 运行日志"));
    remember_error(state, gsp_mifi_about_row_set_text(state->ui, en ? "　　　 About" : "　　　 关于设备"));
    remember_error(state, gsp_mifi_factory_reset_set_text(state->ui, en ? "　　　 Factory reset" : "　　　 恢复出厂设置"));
    remember_error(state, gsp_mifi_nav_4_0_set_text(state->ui, en ? "Home" : "首页"));
    remember_error(state, gsp_mifi_nav_4_1_set_text(state->ui, en ? "Wi-Fi" : "Wi-Fi"));
    remember_error(state, gsp_mifi_nav_4_2_set_text(state->ui, en ? "Devices" : "设备"));
    remember_error(state, gsp_mifi_nav_4_3_set_text(state->ui, en ? "Cellular" : "蜂窝"));
    remember_error(state, gsp_mifi_nav_4_4_set_text(state->ui, en ? "System" : "系统"));
    remember_error(state, gsp_mifi_reset_title_set_text(state->ui, en ? "Factory reset?" : "恢复出厂设置？"));
    remember_error(state, gsp_mifi_reset_detail_set_text(state->ui, en ? "Resets hotspot name, password, security, brightness and sleep." : "将恢复默认热点名称、密码、安全方式、亮度与息屏设置。"));
    remember_error(state, gsp_mifi_reset_cancel_set_text(state->ui, en ? "Cancel" : "取消"));
    remember_error(state, gsp_mifi_reset_confirm_set_text(state->ui, en ? "Reset" : "确认恢复"));
    remember_error(state, gsp_mifi_title_diagnostics_set_text(state->ui, en ? "Diagnostics" : "网络诊断"));
    remember_error(state, gsp_mifi_diag_ok_set_text(state->ui, en ? "Connection is healthy" : "网络连接正常"));
    remember_error(state, gsp_mifi_diag_when_set_text(state->ui, en ? "Checked just now" : "刚刚检测"));
    remember_error(state, gsp_mifi_diag_modem_title_set_text(state->ui, en ? "Modem" : "4G 模组"));
    remember_error(state, gsp_mifi_diag_modem_detail_set_text(state->ui, en ? "Connected" : "已连接"));
    remember_error(state, gsp_mifi_diag_cell_title_set_text(state->ui, en ? "Cellular" : "蜂窝网络"));
    remember_error(state, gsp_mifi_diag_cell_detail_set_text(state->ui, en ? "China Unicom 4G" : "中国联通 4G"));
    remember_error(state, gsp_mifi_diag_rndis_title_set_text(state->ui, en ? "RNDIS" : "RNDIS"));
    remember_error(state, gsp_mifi_diag_rndis_detail_set_text(state->ui, en ? "192.168.43.100" : "192.168.43.100"));
    remember_error(state, gsp_mifi_diag_net_title_set_text(state->ui, en ? "Internet" : "互联网"));
    remember_error(state, gsp_mifi_diag_net_detail_set_text(state->ui, en ? "DNS and WAN OK" : "DNS 与公网正常"));
    remember_error(state, gsp_mifi_diag_rsrp_set_text(state->ui, en ? "RSRP  -92 dBm" : "RSRP  -92 dBm"));
    remember_error(state, gsp_mifi_diag_sinr_set_text(state->ui, en ? "SINR  18 dB" : "SINR  18 dB"));
    remember_error(state, gsp_mifi_diag_drop_set_text(state->ui, en ? "Last drop  none" : "最近掉线  无"));
    remember_error(state, gsp_mifi_diag_recheck_set_text(state->ui, en ? "Check again" : "重新检测"));
    remember_error(state, gsp_mifi_title_update_set_text(state->ui, en ? "System update" : "系统更新"));
    remember_error(state, gsp_mifi_update_status_set_text(state->ui, en ? "Already up to date" : "已是最新版本"));
    remember_error(state, gsp_mifi_update_app_title_set_text(state->ui, en ? "App version" : "应用版本"));
    remember_error(state, gsp_mifi_update_app_value_set_text(state->ui, en ? "1.0.0" : "1.0.0"));
    remember_error(state, gsp_mifi_update_vibe_title_set_text(state->ui, en ? "Vibe Mode" : "Vibe Mode"));
    remember_error(state, gsp_mifi_update_vibe_value_set_text(state->ui, en ? "0.2.x" : "0.2.x"));
    remember_error(state, gsp_mifi_update_checked_title_set_text(state->ui, en ? "Last check" : "上次检查"));
    remember_error(state, gsp_mifi_update_checked_value_set_text(state->ui, en ? "Today 10:28" : "今天 10:28"));
    remember_error(state, gsp_mifi_update_check_set_text(state->ui, en ? "Check for updates" : "检查更新"));
    remember_error(state, gsp_mifi_update_note_set_text(state->ui, en ? "The hotspot pauses during an update, then returns" : "更新期间热点会暂时中断并自动恢复"));
    remember_error(state, gsp_mifi_title_logs_set_text(state->ui, en ? "Runtime logs" : "运行日志"));
    remember_error(state, gsp_mifi_log_0_set_text(state->ui, en ? "Waiting for events..." : "等待系统事件..."));
    remember_error(state, gsp_mifi_log_1_set_text(state->ui, en ? "Wi-Fi SoftAP started" : "Wi-Fi 热点服务已启动"));
    remember_error(state, gsp_mifi_log_2_set_text(state->ui, en ? "USB Host driver ready" : "USB Host 驱动已就绪"));
    remember_error(state, gsp_mifi_log_3_set_text(state->ui, en ? "System initialized" : "系统初始化完成"));
    remember_error(state, gsp_mifi_logs_note_set_text(state->ui, en ? "Live view of the latest 4 hardware & network events" : "实时显示本机最新 4 条硬件与网络事件"));
    remember_error(state, gsp_mifi_title_about_set_text(state->ui, en ? "About" : "关于设备"));
    remember_error(state, gsp_mifi_about_product_set_text(state->ui, en ? "4G Mobile Hotspot" : "4G 随身热点"));
    remember_error(state, gsp_mifi_about_name_title_set_text(state->ui, en ? "Device name" : "设备名称"));
    remember_error(state, gsp_mifi_about_name_value_set_text(state->ui, en ? "Mosaico MiFi" : "Mosaico MiFi"));
    remember_error(state, gsp_mifi_about_model_title_set_text(state->ui, en ? "Model" : "设备型号"));
    remember_error(state, gsp_mifi_about_model_value_set_text(state->ui, en ? "ESP32-S31" : "ESP32-S31"));
    remember_error(state, gsp_mifi_about_modem_title_set_text(state->ui, en ? "4G modem" : "4G 模组"));
    remember_error(state, gsp_mifi_about_modem_value_set_text(state->ui, en ? "ML307C" : "ML307C"));
    remember_error(state, gsp_mifi_about_fw_title_set_text(state->ui, en ? "Modem firmware" : "模组固件"));
    remember_error(state, gsp_mifi_about_fw_value_set_text(state->ui, en ? "MBRH0S00" : "MBRH0S00"));
    remember_error(state, gsp_mifi_about_app_title_set_text(state->ui, en ? "App version" : "应用版本"));
    remember_error(state, gsp_mifi_about_app_value_set_text(state->ui, en ? "1.0.0" : "1.0.0"));
    remember_error(state, gsp_mifi_about_uptime_title_set_text(state->ui, en ? "Uptime" : "运行时长"));
    remember_error(state, gsp_mifi_about_uptime_value_set_text(state->ui, en ? "2 d 06 h" : "2 天 06 小时"));
    remember_error(state, gsp_mifi_about_licenses_set_text(state->ui, en ? "Licenses" : "开源许可"));
    remember_error(state, gsp_mifi_about_privacy_set_text(state->ui, en ? "Privacy" : "隐私说明"));
    remember_error(state, gsp_mifi_title_licenses_set_text(state->ui, en ? "Open-source licenses" : "开源许可"));
    remember_error(state, gsp_mifi_licenses_intro_set_text(state->ui, en ? "This product uses the following open-source software:" : "本产品使用以下开源软件："));
    remember_error(state, gsp_mifi_licenses_note_set_text(state->ui, en ? "Full license texts ship with the source and release package." : "完整许可文本随固件源码和发布包提供。"));
    remember_error(state, gsp_mifi_title_privacy_set_text(state->ui, en ? "Privacy" : "隐私说明"));
    remember_error(state, gsp_mifi_privacy_0_set_text(state->ui, en ? "Wi-Fi setup, usage and device names stay on this device." : "Wi-Fi 配置、流量统计和设备名称仅保存在本机。"));
    remember_error(state, gsp_mifi_privacy_1_set_text(state->ui, en ? "Diagnostics never store a full IMSI, ICCID, IMEI or password." : "诊断日志不会记录完整 IMSI、ICCID、IMEI 或密码。"));
    remember_error(state, gsp_mifi_privacy_2_set_text(state->ui, en ? "Exports are redacted and start only when you ask." : "导出诊断信息前会自动脱敏，且仅由用户主动触发。"));
    remember_error(state, gsp_mifi_privacy_3_set_text(state->ui, en ? "Updates check the version only. Traffic is not uploaded." : "系统更新只检查版本信息，不分析或上传用户网络流量。"));
    remember_error(state, gsp_mifi_privacy_reset_set_text(state->ui, en ? "Factory reset clears app settings and keeps identity and Vibe Mode." : "恢复出厂设置会清除应用配置，但保留设备身份与 Vibe Mode。"));
}
